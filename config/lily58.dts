&backlight {
    label = "Backlight Controller";
    status = "okay";
    pwms = <&pwm0 1 10000 PWM_POLARITY_NORMAL>;
    zmk,pwm-led-count = <10>; /* Cambia esto por la cantidad de LEDs */
    zmk,pwm-led-pin = <23>;   /* Cambia este valor según el pin GPIO que controle los LEDs */
};

&chosen {
    zmk,backlight = &backlight;
};
