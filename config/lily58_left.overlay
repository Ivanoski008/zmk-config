&pwm0 {
    compatible = "nordic,nrf-pwm";
    reg = <0x4001c000 0x1000>; /* Dirección base y tamaño del registro */
    status = "okay";
    pinctrl-0 = <&pwm0_default>;
    pinctrl-names = "default";
    zmk,backlight;
};

pwm0_default: pwm0_default {
    group1 {
        psels = <6>; /* P0.06 */
    };
};

&pwm0 {
    status = "okay";
    pinctrl-0 = <&pwm0_default>;

    /* Configuración de los LEDs RGB conectados al mismo pin 6 */
    rgb_led: rgb_leds {
        label = "rgb_leds";
        gpios = <&gpio0 6 GPIO_ACTIVE_HIGH>; /* Todos los LEDs conectados al pin 6 */
        pwms = <&pwm0 0 1000 0>, <&pwm0 1 1000 0>, <&pwm0 2 1000 0>; /* PWM canales 0, 1 y 2 para controlar RGB */
        rgb = <255 0 0>, <0 255 0>, <0 0 255>; /* Rojo, verde y azul (controlados por PWM) */
    };
};

