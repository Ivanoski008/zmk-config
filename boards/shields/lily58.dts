/ {
    zmk,backlight {
        compatible = "zmk,backlight";
        pin = <0x0 0x7>;    // GPIO P0.07 (D6) para retroiluminación
        levels = <5>;       // Cambia el número de niveles según tu preferencia
    };

    zmk,display {
        compatible = "zmk,display";
        i2c = <&i2c1>;      // Usa el bus I2C 1
        width = <128>;      // Ancho de la pantalla OLED
        height = <64>;      // Alto de la pantalla OLED
        sda-pin = <0x0 0xA>; // GPIO P0.10 (D2) para SDA
        scl-pin = <0x0 0xB>; // GPIO P0.11 (D3) para SCL
    };

    zmk,battery {
        compatible = "zmk,battery";
        io-channels = <&adc 0>;   // Canal ADC en GPIO P0.04 (A0)
        full-cell-microvolt = <4200000>;  // Voltaje de batería llena (4.2V)
        empty-cell-microvolt = <3300000>; // Voltaje de batería vacía (3.3V)
    };
};

